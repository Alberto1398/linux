## drivers/gpu/pvr/Kconfig
```kconfig
menuconfig IMG_POWERVR_GPU
	bool "Imagination PowerVR GPU Support"
	default n
	help
	  Say Y here if your SoC contains a Imagination PowerVR GPU. For more
	  information, see <http://www.imgtec.com/powervr/>.

if IMG_POWERVR_GPU

config POWERVR_SGX_5xx
	tristate "PowerVR SGX-540 or SGX-544"
	default n
	help
	  Driver for PowerVR SGX-5xx hardware.

	  Say Y here if your SoC contains a PowerVR SGX-5xx GPU. For more
	  information, see <http://www.imgtec.com/powervr/>.

config POWERVR_ROGUE
	tristate "PowerVR Rogue"
	default n
	help
	  Driver for PowerVR Rogue hardware.

	  Say Y here if your SoC contains a PowerVR Rogue GPU. For more
	  information, see <http://www.imgtec.com/powervr/>.

config POWERVR_ROGUE_LINUX
	tristate "PowerVR Rogue Linux"
	default n
	help
	  Driver for PowerVR Rogue hardware on linux system.

	  Say Y here if your SoC contains a PowerVR Rogue GPU. For more
	  information, see <http://www.imgtec.com/powervr/>.

endif
```

## drivers/media/i2c/camera/Kconfig
```kconfig
#
# Actions CPU si or isp driver and the camera sensors of Actions support 
#
# 

#source "drivers/media/i2c/camera/owl_host/Kconfig"
source "drivers/media/i2c/camera/owl_isp/Kconfig"
source "drivers/media/i2c/camera/owl_imx/Kconfig"
source "drivers/media/i2c/camera/owl_si/Kconfig"
source "drivers/media/i2c/camera/gc5004/Kconfig"
source "drivers/media/i2c/camera/gc2755/Kconfig"
source "drivers/media/i2c/camera/gc2155/Kconfig"
source "drivers/media/i2c/camera/gc0312/Kconfig"
source "drivers/media/i2c/camera/gc2035/Kconfig"
source "drivers/media/i2c/camera/gs5604/Kconfig"
source "drivers/media/i2c/camera/imx0219/Kconfig"
source "drivers/media/i2c/camera/ov2685/Kconfig"
source "drivers/media/i2c/camera/ov5645/Kconfig"
source "drivers/media/i2c/camera/tc358749/Kconfig"
source "drivers/media/i2c/camera/flashlight/Kconfig"
```

## drivers/media/i2c/camera/gc2755/Kconfig
```kconfig
#
# Actions CPU si or isp driver and the camera sensors of Actions support 
#
# 

config GC2755
	tristate "GC2755 camera sensor driver"
	depends on VIDEO_V4L2 && I2C
	help
	  Support for GC2755 camera

	  To compile this driver as a module, choose M here: the
	  module will be called GC2755.
```

## drivers/media/i2c/camera/gc5004/Kconfig
```kconfig
#
# Actions CPU si or isp driver and the camera sensors of Actions support 
#
# 

config GC5004
	tristate "GC5004 camera sensor driver"
	depends on VIDEO_V4L2 && I2C
	help
	  Support for GC5004 camera

	  To compile this driver as a module, choose M here: the
	  module will be called GC5004.
```

## drivers/media/i2c/camera/imx0219/Kconfig
```kconfig
#
# Actions CPU si or isp driver and the camera sensors of Actions support 
#
# 

config IMX0219
	tristate "IMX0219 camera sensor driver"
	depends on VIDEO_V4L2 && I2C
	help
	  Support for IMX0219 camera

	  To compile this driver as a module, choose M here: the
	  module will be called IMX0219.
```

## drivers/media/i2c/camera/ov5645/Kconfig
```kconfig
#
# Actions CPU si or isp driver and the camera sensors of Actions support 
#
# 

config OV5645
	tristate "OV5645 camera sensor driver"
	depends on VIDEO_V4L2 && I2C
	help
	  Support for OV5645 camera

	  To compile this driver as a module, choose M here: the
	  module will be called OV5645.
```

## drivers/media/i2c/camera/owl_imx/Kconfig
```kconfig
#
# Actions CPU si or isp driver and the camera sensors of Actions support 
#
# 

config OWL_CAMERA_IMX
	tristate "owl camera imx driver"
	depends on VIDEO_V4L2
	help
	  Support for owl camera si

	  To compile this driver as a module, choose M here: the
	  module will be called owl camera.
```

## drivers/media/i2c/camera/tc358749/Kconfig
```kconfig
#
# Actions CPU si or isp driver and the hdmi-in sensors of Actions support 
#
# 

config TC358749
	tristate "TC358749 hdmi-in sensor driver"
	depends on VIDEO_V4L2 && I2C
	help
	  Support for TC358749 camera

	  To compile this driver as a module, choose M here: the
	  module will be called TC358749.
```

## drivers/net/ethernet/owl/Kconfig
```kconfig
config NET_OWL_MAC
	tristate "Actions Ethernet driver"
	---help---
		enable Actions Semi ethernet driver
```

## drivers/net/wireless/owl/Kconfig
```kconfig
config BCMDHD
	tristate "Broadcom 4329/30 wireless cards support"
	---help---
	  This module adds support for wireless adapters based on
	  Broadcom 4329/30 chipset.

config BCMDHD_DISABLE_OOB
	depends on BCMDHD
	bool "disable Out-of-Band Interrupt"
	---help---
		disable Interrupt from WL_HOST_WAKE.

config BCMDHD_AP6335
	tristate "Broadcom AP6335 wireless cards support"
	---help---
	  This module adds support for wireless adapters based on
	  Broadcom AP6335 module chipset.

config RTL8723BS
	tristate "Realtek rtl8723bs wireless modules cards support"
	---help---
	  This module adds support for wireless adapters based on
	  sdio.
	  
config RTL8723VQ0
	tristate "Realtek rtl8723bs-vq0 wireless modules cards support"
	---help---
	  This module adds support for wireless adapters based on
	  sdio.
	  
config RTL8723BU
	tristate "Realtek rtl8723bu wireless modules cards support"
	---help---
	  This module adds support for wireless adapters based on
	  usb.

config RTL8188ETV
	tristate "Realtek rtl8188etv wireless modules cards support"
	---help---
	  This module adds support for wireless adapters based on
	  usb.

config RTL8189FS
	tristate "Realtek 8189F SDIO WiFi"
	---help---
	  Help message of RTL8189FS
```

## drivers/pinctrl/owl/Kconfig
```kconfig
#
# Actions OWL SoCs pinctrl drivers
#

if ARCH_OWL

config PINCTRL_OWL
	bool
	select PINMUX
	select GENERIC_PINCONF

config PINCTRL_S900
	bool "Actions S900 pin controller driver"
	depends on ARCH_OWL
	select PINCTRL_OWL
	help
	  Say yes here to support the gpio/pin control module on
	  Actions S900 SoC.
config PINCTRL_S700
	bool "Actions S700 pin controller driver"
	depends on ARCH_OWL
	select PINCTRL_OWL
	help
	  Say yes here to support the gpio/pin control module on
	  Actions S700 SoC.
endif
```

## drivers/soc/Kconfig
```kconfig
menu "SOC (System On Chip) specific Drivers"

source "drivers/soc/owl/Kconfig"

endmenu
```

## drivers/soc/owl/Kconfig
```kconfig
config OWL_CPU_AUTO_HOTPLUG
	bool "owl cpu auto hotplug driver"
	depends on ARCH_OWL
	depends on HOTPLUG_CPU
	help
	  This enables support for cpu auto plugin/out depends on loading
	  to save power consume.
```

## drivers/video/owl/Kconfig
```kconfig
menuconfig VIDEO_OWL
	bool "OWL video support"
	depends on ARCH_OWL
        help
	  Actions OWL Soc video support.

if VIDEO_OWL
source "drivers/video/owl/dss/Kconfig"
source "drivers/video/owl/vce/Kconfig"
source "drivers/video/owl/vde/Kconfig"
source "drivers/video/owl/hde/Kconfig"
endif
```

## drivers/video/owl/dss/Kconfig
```kconfig
source "drivers/video/owl/dss/core/Kconfig"
source "drivers/video/owl/dss/de/Kconfig"
source "drivers/video/owl/dss/controller/Kconfig"
source "drivers/video/owl/dss/panel/Kconfig"
source "drivers/video/owl/dss/fb/Kconfig"
source "drivers/video/owl/dss/adf/Kconfig"
```

## drivers/video/owl/dss/adf/Kconfig
```kconfig
config VIDEO_OWL_ADF
	tristate "OWL ADF support"
	---help---
	  Actions OWL Soc ADF support.

	  Say Y here if you need it in your system.
	  If unsure, say Y.

	  To compile this driver as a module, choose M here.

config VIDEO_OWL_ADF_FBDEV_SUPPORT
        bool "OWL ADF FBDEV Support"
        depends on VIDEO_OWL_ADF
	select FB_CFB_IMAGEBLIT
        ---help---
          Simulate framebuffer device using OWL ADF Driver.

          Say Y here if you need FB function.

          If unsure, say N.

config VIDEO_OWL_ADF_FBDEV_PCBABOARD_SUPPORT
        bool "OWL ADF FBDEV pcba baord Support"
        depends on VIDEO_OWL_ADF
	select FB_CFB_IMAGEBLIT
        ---help---
          Simulate framebuffer device using OWL ADF Driver.

          Say Y here if you need FB function.

          If unsure, say N.
```

## drivers/video/owl/dss/controller/Kconfig
```kconfig
config VIDEO_OWL_CONTROLLERS
	depends on VIDEO_OWL_DSS
	tristate "OWL Display Controllers support"
	---help---
	  Actions OWL Soc Display Controllers support.

	  Say Y here if you need it in your system.
	  If unsure, say Y.

	  To compile this driver as a module, choose M here.

config VIDEO_OWL_EDPC
	depends on VIDEO_OWL_CONTROLLERS
	tristate "OWL EDP Controllers support"
	---help---
	  Actions OWL Soc EDP Controller support.

	  Say Y here if you need it in your system.
	  If unsure, say Y.

	  To compile this driver as a module, choose M here.

config VIDEO_OWL_LCDC
	depends on VIDEO_OWL_CONTROLLERS
	tristate "OWL LCD/LVDS Controllers support"
	---help---
	  Actions OWL Soc LCD/LVDS Controller support.

	  Say Y here if you need it in your system.
	  If unsure, say Y.

	  To compile this driver as a module, choose M here.
config VIDEO_OWL_DSIC
	depends on VIDEO_OWL_CONTROLLERS
	tristate "OWL MIPI Controllers support"
	---help---
	  Actions OWL Soc MIPI Controller support.

	  Say Y here if you need it in your system.
	  If unsure, say Y.

	  To compile this driver as a module, choose M here.
source "drivers/video/owl/dss/controller/dsic/Kconfig"

config VIDEO_OWL_HDMIC
	depends on VIDEO_OWL_CONTROLLERS
	tristate "OWL HDMI Controllers support"
	---help---
	  Actions OWL Soc HDMI Controller support.

	  Say Y here if you need it in your system.
	  If unsure, say Y.

	  To compile this driver as a module, choose M here.

source "drivers/video/owl/dss/controller/hdmic/Kconfig"

config VIDEO_OWL_CVBSC
	depends on VIDEO_OWL_CONTROLLERS
	tristate "OWL CVBS Controllers support"
	---help---
	  Actions OWL Soc CVBS Controller support.

	  Say Y here if you need it in your system.
	  If unsure, say Y.

	  To compile this driver as a module, choose M here.

source "drivers/video/owl/dss/controller/cvbsc/Kconfig"


config VIDEO_OWL_DUMMY_DISPC
	depends on VIDEO_OWL_CONTROLLERS
	tristate "OWL Dummy Controllers support"
	---help---
	  Actions OWL Soc Dummy Controller support.

	  Say Y here if you need it in your system.
	  If unsure, say Y.

	  To compile this driver as a module, choose M here.
```

## drivers/video/owl/dss/controller/hdmic/Kconfig
```kconfig
config VIDEO_OWL_HDMI_IP_SX00
	depends on VIDEO_OWL_HDMIC
	tristate "OWL SX00 HDMI IP support"
	---help---
	  Actions OWL SX00(S500/S900/S700) HDMI IP support.

	  Say Y here if you need it in your system.
	  If unsure, say Y.

	  To compile this driver as a module, choose M here.
```

## drivers/video/owl/dss/core/Kconfig
```kconfig
config VIDEO_OWL_DSS
	tristate "OWL Display Subsystem Core"
	---help---
	  Actions OWL Soc Display Subsystem support.

	  Say Y here if you need it in your system.
	  If unsure, say Y.

	  To compile this driver as a module, choose M here.
```

## drivers/video/owl/dss/de/Kconfig
```kconfig
config VIDEO_OWL_DE
	depends on VIDEO_OWL_DSS
	tristate "OWL DE support"
	---help---
	  Actions OWL Soc S900 Display Engine support.

	  Say Y here if you need it in your system.
	  If unsure, say Y.

	  To compile this driver as a module, choose M here.

config VIDEO_OWL_DE_S900
	depends on VIDEO_OWL_DE
	bool "OWL S900 DE support"
	---help---
	  Actions OWL Soc S900 DE support.

	  Say Y here if you need it in your system.
	  If unsure, say Y.

	  To compile this driver as a module, choose M here.

config VIDEO_OWL_DE_S700
	depends on VIDEO_OWL_DE
	bool "OWL S700 DE support"
	---help---
	  Actions OWL Soc S700 DE support.

	  Say Y here if you need it in your system.
	  If unsure, say Y.

	  To compile this driver as a module, choose M here.
```

## drivers/video/owl/dss/fb/Kconfig
```kconfig
config VIDEO_OWL_FB
	tristate "OWL Framebuffer support"
	depends on VIDEO_OWL_DSS
	select FB_CFB_FILLRECT
	select FB_CFB_COPYAREA
	select FB_CFB_IMAGEBLIT
	---help---
	  Actions OWL Soc FB driver support.

	  Say Y here if you need it in your system.
	  If unsure, say Y.

	  To compile this driver as a module, choose M here.
```

## drivers/video/owl/dss/panel/Kconfig
```kconfig
config VIDEO_OWL_PANELS
	depends on VIDEO_OWL_DSS
	tristate "OWL Display Panels support"
	---help---
	  Actions OWL Soc Display Panels support.

	  Say Y here if you need it in your system.
	  If unsure, say Y.

	  To compile this driver as a module, choose M here.

config VIDEO_OWL_GLP
	depends on VIDEO_OWL_PANELS
	tristate "OWL Generic LCD/LVDS Panel support"
	---help---
	  Actions OWL Soc Generic LCD/LVDS Panel support.

	  Say Y here if you need it in your system.
	  If unsure, say Y.

	  To compile this driver as a module, choose M here.

config VIDEO_OWL_GEP
	depends on VIDEO_OWL_PANELS
	tristate "OWL Generic EDP Panel support"
	---help---
	  Actions OWL Soc Generic EDP Panel support.

	  Say Y here if you need it in your system.
	  If unsure, say Y.

	  To compile this driver as a module, choose M here.

config VIDEO_OWL_TC358860
	depends on VIDEO_OWL_PANELS
	tristate "OWL particular edp2dsi Panel support"
	---help---
	  Actions OWL Soc particular edp2dsi Panel support.

	  Say Y here if you need it in your system.
	  If unsure, say Y.

	  To compile this driver as a module, choose M here.

config VIDEO_OWL_GMP
	depends on VIDEO_OWL_PANELS
	tristate "OWL Generic MIPI Panel support"
	---help---
	  Actions OWL Soc Generic MIPI Panel support.

	  Say Y here if you need it in your system.
	  If unsure, say Y.

	  To compile this driver as a module, choose M here.

config VIDEO_OWL_GHP
	depends on VIDEO_OWL_PANELS
	tristate "OWL Generic HDMI Panel support"
	---help---
	  Actions OWL Soc Generic HDMI Panel support.

	  Say Y here if you need it in your system.
	  If unsure, say Y.

	  To compile this driver as a module, choose M here.
config VIDEO_OWL_GCP
	depends on VIDEO_OWL_PANELS
	tristate "OWL Generic CVBS Panel support"
	---help---
	  Actions OWL Soc Generic CVBS Panel support.

	  Say Y here if you need it in your system.
	  If unsure, say Y.

	  To compile this driver as a module, choose M here.

config VIDEO_OWL_GDP
	depends on VIDEO_OWL_PANELS
	tristate "OWL Generic Dummy Panel support"
	---help---
	  Actions OWL Soc Generic Dummy Panel support.

	  Say Y here if you need it in your system.
	  If unsure, say Y.

	  To compile this driver as a module, choose M here.

config VIDEO_OWL_lq055t3sx02
	depends on VIDEO_OWL_PANELS
	tristate "OWL lq055t3sx02 MIPI Panel support"
	---help---
	  Actions OWL Soc lq055t3sx02 MIPI Panel support.

	  Say Y here if you need it in your system.
	  If unsure, say Y.

	  To compile this driver as a module, choose M here.

config VIDEO_OWL_AMOLED
	depends on VIDEO_OWL_PANELS
	tristate "OWL AMOLED MIPI Panel support"
	---help---
	  Actions OWL Soc AMOLED MIPI Panel support.

	  Say Y here if you need it in your system.
	  If unsure, say Y.

	  To compile this driver as a module, choose M here.
```

## drivers/video/owl/hde/Kconfig
```kconfig
config VIDEO_ACTIONS_HDE
	tristate "Actions HEVC decoder support"
	depends on ARCH_OWL
	---help---
	  Say Y here if you need video decoder support to your system.

	  If unsure, say N.

	  To compile this driver as a module, choose M here: the
	  module will be called hde_drv.ko.
```

## drivers/video/owl/vde/Kconfig
```kconfig
config VIDEO_ACTIONS_VDE
	tristate "Actions Video decoder support"
	depends on ARCH_OWL
	---help---
	  Say Y here if you need video decoder support to your system.

	  If unsure, say N.

	  To compile this driver as a module, choose M here: the
	  module will be called vde_drv.ko.
```
