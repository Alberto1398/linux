/*
 * Copyright (C) 2014 Actions Semi. Inc
 *
 * This program is free software; you can redistribute it and/or
 * modify it under the terms of the GNU General Public License as
 * published by the Free Software Foundation version 2.
 *
 * This program is distributed "as is" WITHOUT ANY WARRANTY of any
 * kind, whether express or implied; without even the implied warranty
 * of MERCHANTABILITY or FITNESS FOR A PARTICULAR PURPOSE.  See the
 * GNU General Public License for more details.
 */

#include "s900_evb.dts"

/ {
	chosen {
		bootargs="fb_logo_reserve=0x19000000,0x03000000 console=ttyS0,115200 earlyprintk=serial-owl,0xe0120000 no_console_suspend loglevel=4";
	};
};
